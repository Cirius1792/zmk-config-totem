/*
*
* Copyright (c) 2022 Rafael Romão
* SPDX-License-Identifier: MIT
*
*/

#include <behaviors.dtsi>
#include <dt-bindings/zmk/keys.h>
#include <dt-bindings/zmk/bt.h>

/ {
    #define ACCENTED_KEY(NAME, LABEL_U, LABEL_L, LABEL, KEY, DEAD_KEY) \
        ac_##NAME##_l: ac_##NAME##_l { \
            wait-ms = <0>; \
            tap-ms = <0>; \
            label = LABEL_L; \
            compatible = "zmk,behavior-macro"; \
            #binding-cells = <0>; \
            bindings \
                = <&macro_press &kp LALT> \
                , <&macro_tap &kp DEAD_KEY> \
                , <&macro_release &kp LALT> \
                , <&macro_tap &kp KEY> \
                ; \
        }; \
        ac_##NAME##_u: ac_##NAME##_u { \
            wait-ms = <0>; \
            tap-ms = <0>; \
            label = LABEL_U; \
            compatible = "zmk,behavior-macro"; \
            #binding-cells = <0>; \
            bindings \
                = <&macro_release &kp LSHFT> \
                , <&macro_press &kp LALT> \
                , <&macro_tap &kp DEAD_KEY> \
                , <&macro_release &kp LALT> \
                , <&macro_press &kp LSHFT> \
                , <&macro_tap &kp KEY> \
                , <&macro_release &kp LSHFT> \
                ; \
        }; \
        ac_##NAME: ac_##NAME { \
            label = LABEL; \
            compatible = "zmk,behavior-mod-morph"; \
            #binding-cells = <0>; \
            bindings = <&ac_##NAME##_l>, <&ac_##NAME##_u>; \
            mods = <(MOD_LSFT|MOD_RSFT)>; \
            keep-mods = <(MOD_LSFT|MOD_RSFT)>; \
        };

    accents {
        ACCENTED_KEY(agrv, "à", "À", "àÀ", A, GRAVE)  // à / À
        ACCENTED_KEY(egrv, "è", "È", "èÈ", E, GRAVE)  // è / È
        ACCENTED_KEY(igrv, "ì", "Ì", "ìÌ", I, GRAVE)  // ì / Ì
        ACCENTED_KEY(ogrv, "ò", "Ò", "òÒ", O, GRAVE)  // ò / Ò
        ACCENTED_KEY(ugrv, "ù", "Ù", "ùÙ", U, GRAVE)  // ù / Ù

        ac_ccdi: ac_ccdi {
            wait-ms = <0>;
            tap-ms = <0>;
            label = "ç";
            compatible = "zmk,behavior-macro";
            #binding-cells = <0>;
            bindings
                = <&macro_press &kp LALT>
                , <&macro_tap &kp C>
                , <&macro_release &kp LALT>
                ;
        };
    };
};
